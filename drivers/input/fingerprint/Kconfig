## drivers/input/fingerprint/Kconfig
```kconfig
menu "Device Drivers"

config XIAOMI_FINGERPRINT
	tristate "Xiaomi fingerprint transport"
	depends on OF && INPUT
	help
	  Xiaomi fingerprint platform transport used by the Goodix and QBT
	  userspace HALs. It exposes xiaomi-fp, mifp_id and qbt_ipc devices.

config SILEAD_FP
	tristate "Silead Fingerprint driver support"
	help
	  This supports Silead Fingerprint drivers.

source "$(KCONFIG_EXT_PREFIX)drivers/input/fingerprint/silead/Kconfig"

endmenu
```

## drivers/misc/xiaomi/crash_module/Kconfig
```kconfig
# SPDX-License-Identifier: GPL-2.0-only

config XIAOMI_CRASH_MODULE
	tristate "Xiaomi crash module buffer"
	depends on PROC_FS
```

## drivers/misc/xiaomi/debug_ext/Kconfig
```kconfig
# SPDX-License-Identifier: GPL-2.0-only

config XIAOMI_DEBUG_EXT
	tristate "Xiaomi debug extension"
	depends on PROC_FS
	help
	  Create the Xiaomi panic-trigger proc interface used to request an
	  immediate, reboot-time, or shutdown-time kernel panic.
```

## drivers/misc/xiaomi/hwid/Kconfig
```kconfig
# SPDX-License-Identifier: GPL-2.0-only
#
# Copyright (C) 2026 YorokobiMaster (GitHub: @YorokobiMaster)

config XIAOMI_HWID
	tristate "Xiaomi hardware ID compatibility interface"
	help
	  Expose bootloader-provided Xiaomi project and hardware revision data
	  through read-only module parameters and exported kernel functions.
```

## drivers/misc/xiaomi/mi_memory/Kconfig
```kconfig
# SPDX-License-Identifier: GPL-2.0-only
config XIAOMI_MI_MEMORY
	tristate "Xiaomi memory diagnostics"
	depends on OF && SCSI
	help
	  Xiaomi DRAM and UFS identification, descriptor and health reporting.
```

## drivers/misc/xiaomi/mi_stack/Kconfig
```kconfig
# SPDX-License-Identifier: GPL-2.0-only

config XIAOMI_MI_STACK
	tristate "Xiaomi task kernel stack dumper"
	depends on PROC_FS
	help
	  Expose Xiaomi's PID selector and per-task kernel call trace under
	  /proc/mi_stack.
```

## drivers/misc/xiaomi/mi_ubt/Kconfig
```kconfig
# SPDX-License-Identifier: GPL-2.0-only

config XIAOMI_MI_UBT
	tristate "Xiaomi user backtrace dumper"
	depends on ARM64
	help
	  Unwind AArch64 user frame-pointer chains for Xiaomi panic diagnostics.
```

## drivers/misc/xiaomi/mi_ubt_test/Kconfig
```kconfig
# SPDX-License-Identifier: GPL-2.0-only

config XIAOMI_MI_UBT_TEST
	tristate "Xiaomi user backtrace test"
	depends on PROC_FS
	depends on XIAOMI_MI_UBT
```

## drivers/misc/xiaomi/perf_helper/Kconfig
```kconfig
# SPDX-License-Identifier: GPL-2.0-only

config XIAOMI_PERF_HELPER
	tristate "Xiaomi memory and performance helper"
	depends on MEMCG
	help
	  Provide the Xiaomi performance logging, reclaim, memory-cgroup,
	  kswapd affinity, and MIMD notification interfaces used by HyperOS.
```

## drivers/tee/mitee/Kconfig
```kconfig
# MI-TEE Trusted Execution Environment Configuration
config MITEE_SUPPORT
	tristate "Enable MITEE Support"
	help
	  This implements the MI-TEE Trusted Execution Environment (TEE)
	  feature.

config OPTEE_SHM_NUM_PRIV_PAGES
	int "Private Shared Memory Pages"
	default 1
	depends on MITEE_SUPPORT
	help
	  This sets the number of private shared memory pages to be
	  used by the MITEE TEE driver.

config OPTEE_BENCHMARK
	bool "MITEE Benchmark (EXPERIMENTAL)"
	depends on MITEE_SUPPORT
	help
	  This enables benchmarking support in the MITEE TEE driver.

# MITEE TUI Configuration
config MITEE_TUI_SUPPORT
	tristate "Enable MITEE TUI Support"
	depends on MITEE_SUPPORT
	help
	  This enables the separate MITEE trusted UI driver.
```
